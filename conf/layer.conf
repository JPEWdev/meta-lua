## conf/layer.conf
```bitbake
# We have a conf and classes directory, add to BBPATH
BBPATH := "${BBPATH}:${LAYERDIR}"

# We have a packages directory, add to BBFILES
BBFILES += "${LAYERDIR}/recipes*/*/*.bb ${LAYERDIR}/recipes*/*/*.bbappend"

BBFILE_COLLECTIONS += "meta-lua"
BBFILE_PATTERN_meta-lua := "^${LAYERDIR}/"
BBFILE_PRIORITY_meta-lua = "8"

LAYERDEPENDS_meta-lua = "core"

LAYERSERIES_COMPAT_meta-lua = "dunfell"
```
